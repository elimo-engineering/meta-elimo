## conf/machine/elimo-initium.conf
```bitbake
#@TYPE: Machine
#@NAME: elimo-initium
#@DESCRIPTION: Machine configuration for the Elimo Initium, based on the Elimo Impetus SoM, based on Sochip S3 CPU

require conf/machine/include/sun8i.inc


UBOOT_MACHINE = "elimo_initium_defconfig"
KERNEL_DEVICETREE = "sun8i-s3-elimo-initium.dtb"
```
